// SPDX-License-Identifier: GPL-2.0
/*
 * Copyright (c) 2019 Raphiel Rollerscaperers <raphielscape@raphielgang.org>
 */

#include "dsi-panel-tianma-fhd-nt36672a-video.dtsi"

&soc {
	dsi_tianma_fhd_nt36672a_video_display: qcom,dsi-display@21 {
		compatible = "qcom,dsi-display";
		label = "dsi_tianma_fhd_nt36672a_video_display";
		qcom,display-type = "primary";

		qcom,dsi-ctrl = <&mdss_dsi0>;
		qcom,dsi-phy = <&mdss_dsi_phy0>;
		clocks = <&mdss_dsi0_pll BYTECLK_MUX_0_CLK>,
			<&mdss_dsi0_pll PCLK_MUX_0_CLK>;
		clock-names = "mux_byte_clk", "mux_pixel_clk";

		pinctrl-names = "panel_active", "panel_suspend";
		pinctrl-0 = <&sde_dsi_active>;
		pinctrl-1 = <&sde_dsi_suspend>;

		qcom,dsi-panel = <&dsi_tianma_fhd_nt36672a_video>;
		vddio-supply = <&pm8998_l14>;
	};
};
