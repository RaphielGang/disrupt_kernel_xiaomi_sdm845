// SPDX-License-Identifier: GPL-2.0
/*
 * Copyright (c) 2019 Raphiel Rollerscaperers <raphielscape@raphielgang.org>
 */

/dts-v1/;

#include "../qcom/sdm845-v2.1.dtsi"
#include "../qcom/sdm845-mtp.dtsi"
#include "../qcom/sdm845-sde-display.dtsi"
#include "sdm845-xiaomi-common.dtsi"


/ {
	model = "Xiaomi Technologies, Inc. Megalovania new MP v2.1";
	compatible = "qcom,sdm845-mtp", "qcom,sdm845", "qcom,mtp";
	qcom,board-id = <62 0>;
};
