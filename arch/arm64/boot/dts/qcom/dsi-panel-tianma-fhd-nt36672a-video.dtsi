/* Copyright (c) 2015-2019, The Linux Foundation. All rights reserved.
 * Copyright (C) 2019 XiaoMi, Inc.
 * Copyright (c) 2019, Raphielscape LLC.
 *
 * This program is free software; you can redistribute it and/or modify
 * it under the terms of the GNU General Public License version 2 and
 * only version 2 as published by the Free Software Foundation.
 *
 * This program is distributed in the hope that it will be useful,
 * but WITHOUT ANY WARRANTY; without even the implied warranty of
 * MERCHANTABILITY or FITNESS FOR A PARTICULAR PURPOSE.  See the
 * GNU General Public License for more details.
 */

/*---------------------------------------------------------------------------
 * This file is autogenerated file using gcdb parser. Please do not edit it.
 * Update input XML file to add a new entry or update variable in this file
 * VERSION = "1.0"
 *---------------------------------------------------------------------------*/
&soc {
	dsi_tianma_fhd_nt36672a_video: qcom,mdss_dsi_tianma_fhd_nt36672a_video {
		qcom,mdss-dsi-panel-name = "tianma fhd video dsi panel";
		qcom,mdss-dsi-panel-id = <0>;
		qcom,mdss-dsi-panel-model = "TIANMA FHD NT36672A VIDEO PANEL";
		qcom,mdss-dsi-panel-type = "dsi_video_mode";
		qcom,mdss-dsi-virtual-channel-id = <0>;
		qcom,mdss-dsi-stream = <0>;
		qcom,mdss-dsi-bpp = <24>;
		qcom,mdss-dsi-color-order = "rgb_swap_rgb";
		qcom,mdss-dsi-underflow-color = <0xff>;
		qcom,mdss-dsi-border-color = <0>;
		qcom,mdss-dsi-traffic-mode = "burst_mode";
		qcom,mdss-dsi-bllp-eof-power-mode;
		qcom,mdss-dsi-bllp-power-mode;
		qcom,mdss-dsi-lp11-init;
		qcom,mdss-dsi-lane-0-state;
		qcom,mdss-dsi-lane-1-state;
		qcom,mdss-dsi-lane-2-state;
		qcom,mdss-dsi-lane-3-state;
		qcom,mdss-dsi-force-clock-lane-hs;
		qcom,mdss-dsi-bl-min-level = <1>;
		qcom,mdss-dsi-bl-max-level = <4095>;
		qcom,mdss-brightness-max-level = <4095>;
		qcom,mdss-dsi-dma-trigger = "trigger_sw";
		qcom,mdss-dsi-mdp-trigger = "none";
		qcom,mdss-dsi-reset-sequence = <1 1>, <0 1>, <1 10>;
		qcom,mdss-pan-physical-width-dimension = <68>;
		qcom,mdss-pan-physical-height-dimension = <136>;
		qcom,cont-splash-enabled;
		qcom,mdss-dsi-tx-eot-append;

		qcom,mdss-dsi-panel-hdr-enabled;
		qcom,mdss-dsi-panel-hdr-color-primaries = <14500 15500 32000
			17000 15500 30000 8000 3000>;
		qcom,mdss-dsi-panel-peak-brightness = <4200000>;
		qcom,mdss-dsi-panel-blackness-level = <3230>;

		qcom,esd-err-irq-gpio = <&tlmm 10 0x2001>; /* trig-flags: falling-0x0002 rasing-0x0001*/

		qcom,dispparam-enabled;
		qcom,mdss-panel-on-dimming-delay = <120>;

		qcom,mdss-dsi-display-timings {
			timing@0{
				qcom,mdss-dsi-panel-framerate = <60>;
				qcom,mdss-dsi-panel-width = <1080>;
				qcom,mdss-dsi-panel-height = <2246>;
				qcom,mdss-dsi-h-front-porch = <92>;
				qcom,mdss-dsi-h-back-porch = <140>;
				qcom,mdss-dsi-h-pulse-width = <20>;
				qcom,mdss-dsi-h-sync-skew = <0>;
				qcom,mdss-dsi-v-back-porch = <10>;
				qcom,mdss-dsi-v-front-porch = <16>;
				qcom,mdss-dsi-v-pulse-width = <2>;
				qcom,mdss-dsi-h-left-border = <0>;
				qcom,mdss-dsi-h-right-border = <0>;
				qcom,mdss-dsi-v-top-border = <0>;
				qcom,mdss-dsi-v-bottom-border = <0>;

				qcom,mdss-dsi-on-command = [
					15 01 00 00 00 00 02 ff 23
					15 01 00 00 00 00 02 fb 01
					15 01 00 00 00 00 02 07 20
					15 01 00 00 00 00 02 08 04
					15 01 00 00 00 00 02 09 00
					15 01 00 00 00 00 02 ff 25
					15 01 00 00 00 00 02 fb 01
					15 01 00 00 00 00 02 18 96
					15 01 00 00 00 00 02 05 04
					15 01 00 00 00 00 02 ff 27
					15 01 00 00 00 00 02 fb 01
					15 01 00 00 00 00 02 d9 10
					15 01 00 00 00 00 02 ff 24
					15 01 00 00 00 00 02 fb 01
					15 01 00 00 00 00 02 82 13
					15 01 00 00 00 00 02 84 31
					15 01 00 00 00 00 02 88 13
					15 01 00 00 00 00 02 8a 31
					15 01 00 00 00 00 02 8e e4
					15 01 00 00 00 00 02 8f 01
					15 01 00 00 00 00 02 90 80
					15 01 00 00 00 00 02 9d b0
					15 01 00 00 00 00 02 ff 26
					15 01 00 00 00 00 02 fb 01
					15 01 00 00 00 00 02 a9 12
					15 01 00 00 00 00 02 aa 10
					15 01 00 00 00 00 02 ae 8a
					15 01 00 00 00 00 02 1c fa
					15 01 00 00 00 00 02 ff 10
					15 01 00 00 00 00 02 b0 01
					15 01 00 00 00 00 02 51 b8
					39 01 00 00 00 00 03 68 06
					04 15 01 00 00 00 00 02 53
					2c 15 01 00 00 00 00 02 55
					00 05 01 00 00 00 00 02 29
					00 05 01 00 00 46 00 02 11
					00];
				qcom,mdss-dsi-off-command = [
					05 01 00 00 14 00 02 28 00
					05 01 00 00 78 00 02 10 00];
				qcom,mdss-dsi-on-command-state = "dsi_lp_mode";
				qcom,mdss-dsi-off-command-state = "dsi_hs_mode";
				qcom,mdss-dsi-h-sync-pulse = <0>;
			};
		};
	};
};
